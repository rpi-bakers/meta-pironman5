## conf/distro/include/pironman5.inc
```bitbake
require conf/distro/rpi-build.conf

BBMASK += "/meta-raspberrypi/dynamic-layers/multimedia-layer/recipes-multimedia/libcamera/libcamera_.*\.bbappend"

# pironman5 specific settings
ENABLE_UART = "1"
ENABLE_SPI_BUS = "1"
ENABLE_I2C = "1"
ENABLE_IR = "1"
GPIO_IR = "13"

IMAGE_INSTALL:append = " \
    python3-pironman5 \
    python3-pm-auto \
    python3-pm-dashboard \
    python3-sf-rpi-status \
    python3-gpiozero \
    lgpio \
    lirc \
"
```

## conf/distro/pironman5-rpi3.conf
```bitbake
require conf/distro/include/pironman5.inc

DISTRO = "pironman5-rpi3"

# Pin recipe versions for reproducible Base builds.
PREFERRED_VERSION_python3-pironman5 = "1.2.19"
PREFERRED_VERSION_python3-pm-auto = "1.2.12"
PREFERRED_VERSION_python3-pm-dashboard = "1.2.10"
PREFERRED_VERSION_python3-sf-rpi-status = "1.1.0"

DT_OVERLAYS = "sunfounder-pironman5.dtbo"
```

## conf/distro/pironman5.conf
```bitbake
require conf/distro/rpi-build.conf

DISTRO = "pironman5"

# pironman5 specific settings
ENABLE_UART = "1"
ENABLE_SPI_BUS = "1"
ENABLE_I2C = "1"
ENABLE_IR = "1"
GPIO_IR = "13"

# pironman5 required modules
IMAGE_INSTALL:append = " \
    python3-pironman5 \
    python3-pm-auto \
    python3-pm-dashboard \
    python3-sf-rpi-status \
    lgpio \
    \
    python3-gpiozero \
    lirc \
"
```
